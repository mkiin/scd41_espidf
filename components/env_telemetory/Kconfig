## components/env_telemetory/Kconfig
```kconfig
menu "Environment telemetry"

    config ENV_TELEMETRY_HTTP_URL
        string "HTTP endpoint URL"
        default ""
        help
            Full URL of the FastAPI endpoint, for example:
            http://192.168.1.100:8000/api/data
            Use the server address reachable from the ESP32's Wi-Fi network.
            Set this before running the firmware; an empty URL fails init.

endmenu
```

## main/Kconfig.projbuild
```kconfig
menu "Application settings"

    config APP_MEASUREMENT_INTERVAL_SECONDS
        int "Measurement interval in seconds"
        range 30 86400
        default 3600

    config APP_NETWORK_WAIT_SECONDS
        int "Maximum Wi-Fi connection wait in seconds"
        range 1 120
        default 30

    config APP_WIFI_SSID
        string "Wi-Fi SSID"
        default ""

    config APP_WIFI_PASSWORD
        string "Wi-Fi password"
        default ""

    choice APP_API_ENVIRONMENT
        prompt "API environment"
        default APP_API_ENVIRONMENT_PRODUCTION

        config APP_API_ENVIRONMENT_DEVELOPMENT
            bool "Development"

        config APP_API_ENVIRONMENT_PRODUCTION
            bool "Production"
    endchoice

    config APP_DEV_TELEMETRY_URL
        string "Development telemetry URL"
        default ""

    config APP_DEV_AIRMONITOR_API_TOKEN
        string "Development AIRMONITOR_API_TOKEN"
        default ""

    config APP_TELEMETRY_URL
        string "Production telemetry URL"
        default "https://airmonitor-web.mkiin.workers.dev/api/readings"

    config APP_AIRMONITOR_API_TOKEN
        string "Production AIRMONITOR_API_TOKEN"
        default ""

endmenu
```
